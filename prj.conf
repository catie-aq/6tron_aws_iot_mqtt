## CMakeLists.txt
```
# SPDX-License-Identifier: Apache-2.0

cmake_minimum_required(VERSION 3.20.0)

find_package(Zephyr REQUIRED HINTS $ENV{ZEPHYR_BASE})
project(aws_iot_mqtt)

if(USE_DUMMY_CREDS)
  set(creds "src/creds/dummy.c")
else()
  if(NOT EXISTS ${APPLICATION_SOURCE_DIR}/src/creds/key.c OR
     NOT EXISTS ${APPLICATION_SOURCE_DIR}/src/creds/cert.c OR
     NOT EXISTS ${APPLICATION_SOURCE_DIR}/src/creds/ca.c)
    message(FATAL_ERROR
        "Credentials not found. Please run "
        "'python3 src/creds/convert_keys.py' before building"
    )
  endif()

  set(creds "src/creds/ca.c" "src/creds/key.c" "src/creds/cert.c")
endif()

target_sources(app PRIVATE "src/main.c" ${creds})
target_sources(app PRIVATE "src/mqtt_firmware_update.c")
target_sources_ifdef(CONFIG_NET_DHCPV4 app PRIVATE "src/dhcp.c")
```

## Kconfig
```
# 
# Copyright (c) 2023 Lucas Dietrich <ld.adecy@gmail.com>
#
# SPDX-License-Identifier: Apache-2.0
#

menu "ThingsBoard"
mainmenu "ThingsBoard IoT Core MQTT sample application"

config TB_ENDPOINT
	string "ThingsBoard endpoint"
	default ""
	help
	  Endpoint (hostname) of the ThingsBoard MQTT broker.

config TB_THING_NAME
	string "ThingsBoard Device name"
	default "myDeviceName"
	help
	  Set the ThingsBoard Device name created on ThingsBoard.

config TB_SUBSCRIBE_TOPIC
	string "MQTT subscribe topic"
	default "v1/devices/me/attributes"
	help
	  MQTT topic the client should subscribe to.

config TB_PUBLISH_TOPIC
	string "MQTT publish topic"
	default "v1/devices/me/telemetry"
	help
	  MQTT topic the client should publish to.

choice TB_TEST_SUITE
	prompt "Device Advisor test suite"
	default TB_TEST_SUITE_NONE
	help
	  Select the ThingsBoard Device Advisor test suite to run.

config TB_TEST_SUITE_NONE
	bool "No test suite running"

config TB_TEST_SUITE_DQP
	bool "Device Qualification Program (DQP)"
	help
	  Make sure your region supports ThingsBoard Device Advisor for DQP

config TB_TEST_SUITE_RECV_QOS1
	bool "Test suite for receiving QoS 1 messages"
	help
	  For single test case "MQTT Client Puack QoS1"

endchoice

config TB_QOS
	int "MQTT QoS"
	default 0 if TB_TEST_SUITE_DQP
	default 1 if TB_TEST_SUITE_RECV_QOS1
	default 0
	range 0 1
	help
	  Quality of Service to use for publishing and subscribing to topics.
	  Notes:
	  	- Use QoS 0 when passing DQP test suite
	  	- QoS 2 is not supported by ThingsBoard MQTT broker

config TB_EXPONENTIAL_BACKOFF
	bool "Enable exponential backoff"
	default n if TB_TEST_SUITE_DQP || TB_TEST_SUITE_RECV_QOS1
	default y
	help
	  Enable ThingsBoard exponential backoff for reconnecting to ThingsBoard MQTT broker.
endmenu

source "Kconfig.zephyr"
```

## prj.conf
```kconfig
# ThingsBoard Configuration
CONFIG_TB_ENDPOINT="mqtt.thingsboard.cloud"
CONFIG_TB_THING_NAME="RD23-Demo-Device-03"
CONFIG_TB_PUBLISH_TOPIC="v1/devices/me/telemetry"
CONFIG_TB_SUBSCRIBE_TOPIC="v1/devices/me/attributes"
CONFIG_TB_TEST_SUITE_DQP=n

CONFIG_MAIN_STACK_SIZE=4096
CONFIG_ENTROPY_GENERATOR=y
CONFIG_TEST_RANDOM_GENERATOR=y
CONFIG_INIT_STACKS=y
CONFIG_HW_STACK_PROTECTION=y
CONFIG_REQUIRES_FULL_LIBC=y
CONFIG_SNTP=y
CONFIG_JSON_LIBRARY=y
CONFIG_POSIX_CLOCK=y

# DNS
CONFIG_DNS_RESOLVER=y
CONFIG_DNS_RESOLVER_ADDITIONAL_BUF_CTR=2
CONFIG_DNS_RESOLVER_MAX_SERVERS=1
CONFIG_DNS_SERVER_IP_ADDRESSES=y
CONFIG_DNS_SERVER1="8.8.8.8"
CONFIG_NET_SOCKETS_DNS_TIMEOUT=5000
CONFIG_DNS_RESOLVER_LOG_LEVEL_DBG=n

# Generic networking options
CONFIG_NETWORKING=y
CONFIG_NET_UDP=y
CONFIG_NET_TCP=y
CONFIG_NET_IPV6=y
CONFIG_NET_IPV4=y
CONFIG_NET_SOCKETS=y
CONFIG_NET_SOCKETS_SOCKOPT_TLS=y
CONFIG_NET_DHCPV4=y

# Logging
CONFIG_LOG=y
CONFIG_NET_LOG=y

# Network buffers
CONFIG_NET_PKT_RX_COUNT=32
CONFIG_NET_PKT_TX_COUNT=16
CONFIG_NET_BUF_RX_COUNT=64
CONFIG_NET_BUF_TX_COUNT=32

# MQTT
CONFIG_MQTT_LIB=y
CONFIG_MQTT_LIB_TLS=y
CONFIG_MQTT_KEEPALIVE=60

# TLS
CONFIG_MBEDTLS=y
CONFIG_MBEDTLS_BUILTIN=y
CONFIG_MBEDTLS_ENABLE_HEAP=y
CONFIG_MBEDTLS_HEAP_SIZE=65536
CONFIG_MBEDTLS_SSL_MAX_CONTENT_LEN=16384
CONFIG_MBEDTLS_PEM_CERTIFICATE_FORMAT=y
CONFIG_MBEDTLS_SERVER_NAME_INDICATION=y
CONFIG_MBEDTLS_AES_ROM_TABLES=y
CONFIG_MBEDTLS_TLS_VERSION_1_2=y
CONFIG_MBEDTLS_MEMORY_DEBUG=y
CONFIG_MBEDTLS_HAVE_TIME_DATE=y


# mbedTLS key exchange and elliptic curve configuration
CONFIG_MBEDTLS_KEY_EXCHANGE_ECDHE_ECDSA_ENABLED=y
CONFIG_MBEDTLS_ECP_ALL_ENABLED=y  
CONFIG_MBEDTLS_ECDH_C=y 
CONFIG_MBEDTLS_ECDSA_C=y 
CONFIG_MBEDTLS_ECP_C=y  


CONFIG_JSON_LIBRARY=y
```

## src/main.c
```c
#include "creds/creds.h"
#include "dhcp.h"
#include "mqtt_firmware_update.h"

#include <errno.h>
#include <stdio.h>
#include <stdlib.h>
#include <string.h>

#include <zephyr/data/json.h>
#include <zephyr/logging/log.h>
#include <zephyr/net/dns_resolve.h>
#include <zephyr/net/mqtt.h>
#include <zephyr/net/sntp.h>
#include <zephyr/net/socket.h>
#include <zephyr/net/tls_credentials.h>
#include <zephyr/posix/time.h>
#include <zephyr/random/random.h> 
#if defined(CONFIG_MBEDTLS_MEMORY_DEBUG)
#include <mbedtls/memory_buffer_alloc.h>
#endif

LOG_MODULE_REGISTER(tb, LOG_LEVEL_DBG);

#define SNTP_SERVER "0.pool.ntp.org"
#define TB_BROKER_PORT "8883"

#define MQTT_BUFFER_SIZE 256u
#define APP_BUFFER_SIZE 4096u

#define MAX_RETRIES 10u
#define BACKOFF_CONST_MS 5000u
#define SLEEP_TIME_MS 1000

static struct sockaddr_in tb_broker;

static uint8_t rx_buffer[MQTT_BUFFER_SIZE];
static uint8_t tx_buffer[MQTT_BUFFER_SIZE];
static uint8_t buffer[APP_BUFFER_SIZE];

static const char mqtt_client_name[] = CONFIG_TB_THING_NAME;

static uint32_t messages_received_counter;
static bool do_publish;
static bool do_subscribe;

#define TLS_TAG_DEVICE_CERTIFICATE 1
#define TLS_TAG_DEVICE_PRIVATE_KEY 1
#define TLS_TAG_TB_CA_CERTIFICATE 2

static const sec_tag_t sec_tls_tags[] = {
    TLS_TAG_DEVICE_CERTIFICATE,
    TLS_TAG_TB_CA_CERTIFICATE,
};

static int subscribe_to_topics(void) {
    int ret;
    struct mqtt_topic topics[] = {
        {.topic = {.utf8 = CONFIG_TB_SUBSCRIBE_TOPIC,
                   .size = strlen(CONFIG_TB_SUBSCRIBE_TOPIC)},
         .qos = MQTT_QOS_1_AT_LEAST_ONCE},
        {.topic = {.utf8 = "v1/devices/me/attributes/response/+",
                   .size = strlen("v1/devices/me/attributes/response/+")},
         .qos = MQTT_QOS_1_AT_LEAST_ONCE},
        {.topic = {.utf8 = "v2/fw/response/+",
                   .size = strlen("v2/fw/response/+")},
         .qos = MQTT_QOS_1_AT_LEAST_ONCE},
        {.topic = {.utf8 = "v2/fw/response/+/chunk/+",
                   .size = strlen("v2/fw/response/+/chunk/+")},
         .qos = MQTT_QOS_1_AT_LEAST_ONCE}
    };
    const struct mqtt_subscription_list sub_list = {
        .list = topics,
        .list_count = ARRAY_SIZE(topics),
        .message_id = 1u,
    };

    LOG_INF("Subscribing to %hu topic(s)", sub_list.list_count);

    ret = mqtt_subscribe(&client_ctx, &sub_list);
    if (ret != 0) {
        LOG_ERR("Failed to subscribe to topics: %d", ret);
    }

    return ret;
}

static int publish_message(const char *topic, size_t topic_len,
                           uint8_t *payload, size_t payload_len) {
    static uint32_t message_id = 1u;

    int ret;
    struct mqtt_publish_param msg;

    msg.retain_flag = 0u;
    msg.message.topic.topic.utf8 = topic;
    msg.message.topic.topic.size = topic_len;
    msg.message.topic.qos = MQTT_QOS_1_AT_LEAST_ONCE;
    msg.message.payload.data = payload;
    msg.message.payload.len = payload_len;
    msg.message_id = message_id++;

    ret = mqtt_publish(&client_ctx, &msg);
    if (ret != 0) {
        LOG_ERR("Failed to publish message: %d", ret);
    }

    LOG_INF("PUBLISHED on topic \"%s\" [ id: %u qos: %u ], payload: %zu B", topic,
            msg.message_id, msg.message.topic.qos, payload_len);
    LOG_HEXDUMP_DBG(payload, payload_len, "Published payload:");

    return ret;
}

static ssize_t handle_published_message(const struct mqtt_publish_param *pub) {
    int ret;
    size_t received = 0u;
    const size_t message_size = pub->message.payload.len;
    const bool discarded = message_size > APP_BUFFER_SIZE;

    LOG_INF("RECEIVED on topic \"%s\" [ id: %u qos: %u ] payload: %u / %u B",
            (const char *)pub->message.topic.topic.utf8, pub->message_id,
            pub->message.topic.qos, message_size, APP_BUFFER_SIZE);

     while (received < message_size) {
        uint8_t *p = discarded ? buffer : &buffer[received];

        ret = mqtt_read_publish_payload_blocking(&client_ctx, p, APP_BUFFER_SIZE);
        if (ret < 0) {
            return ret;
        }

        received += ret;    
    }
   
    LOG_HEXDUMP_DBG(buffer, MIN(message_size, 256u), "Received payload:");

    process_message(pub, buffer, message_size);
    
    return 0;
}

const char *mqtt_evt_type_to_str(enum mqtt_evt_type type) {
    static const char *const types[] = {
        "CONNACK", "DISCONNECT", "PUBLISH", "PUBACK",   "PUBREC",
        "PUBREL",  "PUBCOMP",    "SUBACK",  "UNSUBACK", "PINGRESP",
    };

    return (type < ARRAY_SIZE(types)) ? types[type] : "<unknown>";
}

static void mqtt_event_cb(struct mqtt_client *client,
                          const struct mqtt_evt *evt) {
    LOG_DBG("MQTT event: %s [%u] result: %d", mqtt_evt_type_to_str(evt->type),
            evt->type, evt->result);

    switch (evt->type) {
        case MQTT_EVT_CONNACK: {
            do_subscribe = true;
        } break;

        case MQTT_EVT_PUBLISH: {
            const struct mqtt_publish_param *pub = &evt->param.publish;

            handle_published_message(pub);
            messages_received_counter++;
            do_publish = true;
        } break;

        case MQTT_EVT_SUBACK: {
            do_publish = true;
        } break;

        case MQTT_EVT_PUBACK:
        case MQTT_EVT_DISCONNECT:
        case MQTT_EVT_PUBREC:
        case MQTT_EVT_PUBREL:
        case MQTT_EVT_PUBCOMP:
        case MQTT_EVT_PINGRESP:
        case MQTT_EVT_UNSUBACK:
        default:
            break;
    }
}

static void tb_client_setup(void) {
    mqtt_client_init(&client_ctx);

    client_ctx.broker = &tb_broker;
    client_ctx.evt_cb = mqtt_event_cb;
    client_ctx.client_id.utf8 = (uint8_t *)mqtt_client_name;
    client_ctx.client_id.size = sizeof(mqtt_client_name) - 1;
    client_ctx.password = NULL;
    client_ctx.user_name = NULL;
    client_ctx.keepalive = CONFIG_MQTT_KEEPALIVE;
    client_ctx.protocol_version = MQTT_VERSION_3_1_1;

    client_ctx.rx_buf = rx_buffer;
    client_ctx.rx_buf_size = MQTT_BUFFER_SIZE;
    client_ctx.tx_buf = tx_buffer;
    client_ctx.tx_buf_size = MQTT_BUFFER_SIZE;

    client_ctx.transport.type = MQTT_TRANSPORT_SECURE;
    struct mqtt_sec_config *const tls_config = &client_ctx.transport.tls.config;

    tls_config->peer_verify = TLS_PEER_VERIFY_REQUIRED;
    tls_config->cipher_list = NULL;
    tls_config->sec_tag_list = sec_tls_tags;
    tls_config->sec_tag_count = ARRAY_SIZE(sec_tls_tags);
    tls_config->hostname = CONFIG_TB_ENDPOINT;
    tls_config->cert_nocopy = TLS_CERT_NOCOPY_NONE;
}

struct backoff_context {
    uint16_t retries_count;
    uint16_t max_retries;
};

static void backoff_context_init(struct backoff_context *bo) {
    __ASSERT_NO_MSG(bo != NULL);

    bo->retries_count = 0u;
    bo->max_retries = MAX_RETRIES;
}

static void backoff_get_next(struct backoff_context *bo,
                             uint32_t *next_backoff_ms) {
    __ASSERT_NO_MSG(bo != NULL);
    __ASSERT_NO_MSG(next_backoff_ms != NULL);

    *next_backoff_ms = BACKOFF_CONST_MS;
}

static int tb_client_try_connect(void) {
    int ret;
    uint32_t backoff_ms;
    struct backoff_context bo;

    backoff_context_init(&bo);

    while (bo.retries_count <= bo.max_retries) {
        ret = mqtt_connect(&client_ctx);
        if (ret == 0) {
            goto exit;
        }

        backoff_get_next(&bo, &backoff_ms);

        LOG_ERR("Failed to connect: %d backoff delay: %u ms", ret, backoff_ms);
        k_msleep(backoff_ms);
    }

exit:
    return ret;
}

struct publish_payload {
    uint32_t counter;
};

static const struct json_obj_descr json_descr[] = {
    JSON_OBJ_DESCR_PRIM(struct publish_payload, counter, JSON_TOK_NUMBER),
};

static int publish(void) {
    struct publish_payload pl = {.counter = messages_received_counter};

    json_obj_encode_buf(json_descr, ARRAY_SIZE(json_descr), &pl, buffer,
                        sizeof(buffer));

    return publish_message(CONFIG_TB_PUBLISH_TOPIC,
                           strlen(CONFIG_TB_PUBLISH_TOPIC), buffer,
                           strlen(buffer));
}

void tb_client_loop(void) {
    int rc;
    int timeout;
    struct zsock_pollfd fds;

    tb_client_setup();

    rc = tb_client_try_connect();
    if (rc != 0) {
        goto cleanup;
    }

    fds.fd = client_ctx.transport.tcp.sock;
    fds.events = ZSOCK_POLLIN;

    for (;;) {
        timeout = mqtt_keepalive_time_left(&client_ctx);
        rc = zsock_poll(&fds, 1u, timeout);
        if (rc >= 0) {
            if (fds.revents & ZSOCK_POLLIN) {
                rc = mqtt_input(&client_ctx);
                if (rc != 0) {
                    LOG_ERR("Failed to read MQTT input: %d", rc);
                    break;
                }
            }

            if (fds.revents & (ZSOCK_POLLHUP | ZSOCK_POLLERR)) {
                LOG_ERR("Socket closed/error");
                break;
            }

            rc = mqtt_live(&client_ctx);
            if ((rc != 0) && (rc != -EAGAIN)) {
                LOG_ERR("Failed to live MQTT: %d", rc);
                break;
            }
        } else {
            LOG_ERR("poll failed: %d", rc);
            break;
        }

        if (do_publish) {
            do_publish = false;
            publish();
        }

        if (do_subscribe) {
            do_subscribe = false;
            subscribe_to_topics();
            request_firmware_info();
        }

        // if (do_firmware_update) {
        //     do_firmware_update = false;
        //     get_firmware(chunk_number);
        // }
    }

cleanup:
    mqtt_disconnect(&client_ctx);

    zsock_close(fds.fd);
    fds.fd = -1;
}

int sntp_sync_time(void) {
    int rc;
    struct sntp_time now;
    struct timespec tspec;

    rc = sntp_simple(SNTP_SERVER, SYS_FOREVER_MS, &now);
    if (rc == 0) {
        tspec.tv_sec = now.seconds;
        tspec.tv_nsec = ((uint64_t)now.fraction * (1000lu * 1000lu * 1000lu)) >> 32;

        clock_settime(CLOCK_REALTIME, &tspec);

        LOG_DBG("Acquired time from NTP server: %u", (uint32_t)tspec.tv_sec);
    } else {
        LOG_ERR("Failed to acquire SNTP, code %d\n", rc);
    }
    return rc;
}

static int resolve_broker_addr(struct sockaddr_in *broker) {
    int ret;
    struct zsock_addrinfo *ai = NULL;

    const struct zsock_addrinfo hints = {
        .ai_family = AF_INET,
        .ai_socktype = SOCK_STREAM,
        .ai_protocol = 0,
    };

    ret = zsock_getaddrinfo(CONFIG_TB_ENDPOINT, TB_BROKER_PORT, &hints, &ai);
    if (ret == 0) {
        char addr_str[INET_ADDRSTRLEN];

        memcpy(broker, ai->ai_addr,
               MIN(ai->ai_addrlen, sizeof(struct sockaddr_storage)));

        zsock_inet_ntop(AF_INET, &broker->sin_addr, addr_str, sizeof(addr_str));
        LOG_INF("Resolved: %s:%u", addr_str, htons(broker->sin_port));
    } else {
        LOG_ERR("failed to resolve hostname err = %d (errno = %d)", ret, errno);
    }

    zsock_freeaddrinfo(ai);

    return ret;
}

static int setup_credentials(void) {
    int ret;

    ret = tls_credential_add(TLS_TAG_DEVICE_CERTIFICATE,
                             TLS_CREDENTIAL_SERVER_CERTIFICATE, public_cert,
                             public_cert_len);
    if (ret < 0) {
        LOG_ERR("Failed to add device certificate: %d", ret);
        goto exit;
    }

    ret = tls_credential_add(TLS_TAG_DEVICE_PRIVATE_KEY, TLS_CREDENTIAL_PRIVATE_KEY,
                             private_key, private_key_len);
    if (ret < 0) {
        LOG_ERR("Failed to add device private key: %d", ret);
        goto exit;
    }

    ret = tls_credential_add(TLS_TAG_TB_CA_CERTIFICATE,
                             TLS_CREDENTIAL_CA_CERTIFICATE, ca_cert, ca_cert_len);
    if (ret < 0) {
        LOG_ERR("Failed to add device CA certificate: %d", ret);
        goto exit;
    }

exit:
    return ret;
}

int main(void) {
#if defined(CONFIG_NET_DHCPV4)
    app_dhcpv4_startup();
#endif

    sntp_sync_time();

    setup_credentials();

    for (;;) {
        resolve_broker_addr(&tb_broker);

        tb_client_loop();

#if defined(CONFIG_MBEDTLS_MEMORY_DEBUG)
        size_t cur_used, cur_blocks, max_used, max_blocks;

        mbedtls_memory_buffer_alloc_cur_get(&cur_used, &cur_blocks);
        mbedtls_memory_buffer_alloc_max_get(&max_used, &max_blocks);
        LOG_INF("mbedTLS heap usage: MAX %zu/%u (%u) CUR %zu (%u)", max_used,
                CONFIG_MBEDTLS_HEAP_SIZE, max_blocks, cur_used, cur_blocks);
#endif

        k_sleep(K_SECONDS(1));
    }

    return 0;
}
```

## src/dhcp.c
```c
/* DHCPv4 client startup. */

/*
 * Copyright (c) 2024, CATIE
 * SPDX-License-Identifier: Apache-2.0
 */

#include <zephyr/logging/log.h>

LOG_MODULE_DECLARE(tb, LOG_LEVEL_DBG);

#include <zephyr/kernel.h>

#include <zephyr/net/net_context.h>
#include <zephyr/net/net_core.h>
#include <zephyr/net/net_if.h>
#include <zephyr/net/net_mgmt.h>


static struct net_mgmt_event_callback mgmt_cb;

/* Semaphore to indicate a lease has been acquired. */
static K_SEM_DEFINE(got_address, 0, 1);

static void handler(struct net_mgmt_event_callback *cb, uint32_t mgmt_event,
                    struct net_if *iface) {
  int i;
  bool notified = false;

  if (mgmt_event != NET_EVENT_IPV4_ADDR_ADD) {
    return;
  }

  for (i = 0; i < NET_IF_MAX_IPV4_ADDR; i++) {
    if (iface->config.ip.ipv4->unicast[i].addr_type != NET_ADDR_DHCP) {
      continue;
    }

    if (!notified) {
      k_sem_give(&got_address);
      notified = true;
    }
    break;
  }
}

/**
 * Start a DHCP client, and wait for a lease to be acquired.
 */
void app_dhcpv4_startup(void) {
  LOG_INF("starting DHCPv4");

  net_mgmt_init_event_callback(&mgmt_cb, handler, NET_EVENT_IPV4_ADDR_ADD);
  net_mgmt_add_event_callback(&mgmt_cb);

  net_dhcpv4_start(net_if_get_default());

  /* Wait for a lease. */
  k_sem_take(&got_address, K_FOREVER);
}
```

## src/mqtt_firmware_update.c
```c
#include "mqtt_firmware_update.h"
#include <stdio.h>
#include <stdlib.h>
#include <string.h>
#include <zephyr/data/json.h>
#include <zephyr/logging/log.h>
#include <zephyr/net/mqtt.h>
#include <zephyr/random/random.h>

struct mqtt_client client_ctx;
int firmware_request_id = 10;
int chunk_count = 0;
int chunk_number = 0;
int firmware_chunk_size = 3200;
struct json_key_value {
  char value[128];
};
bool do_firmware_update = false;

LOG_MODULE_DECLARE(tb);

char *current_firmware_to_json() {
  static char firmware_infos[96];
  sprintf(firmware_infos,
          "{\"current_fw_title\":\"%s\",\"current_fw_version\":\"%s\"}",
          current_firmware_title, current_firmware_version);
  return firmware_infos;
}

int update_response_topic_name(char *topic_name) {
  sprintf(topic_name, "v2/fw/response/%d/chunk/", firmware_request_id);
  return 0;
}

int update_request_topic_name(char *topic_name, int chunk_number) {
  sprintf(topic_name, "v2/fw/request/%d/chunk/%d", firmware_request_id,
          chunk_number);
  return 0;
}

int send_message(char *topic, char *payload) {
  struct mqtt_publish_param param;
  param.message.topic.qos = MQTT_QOS_1_AT_LEAST_ONCE;
  param.message.topic.topic.utf8 = topic;
  param.message.topic.topic.size = strlen(topic);
  param.message.payload.data = payload;
  param.message.payload.len = strlen(payload);
  param.message_id = sys_rand32_get();
  param.dup_flag = 0;
  param.retain_flag = 0;

  int ret = mqtt_publish(&client_ctx, &param);
  if (ret) {
    LOG_ERR("Failed to publish message to topic %s: %d", topic, ret);
  } else {
    LOG_INF("Message published successfully to topic %s", topic);
  }
  return ret;
}

// Payload is the firmware binary chunk
int store_firmware_chunk(void *payload, int chunk_number, int chunk_len) {
  printf("TODO: write chunk %d (len:%d) to flash\n", chunk_number, chunk_len);

  // Store the firmware chunk in the flash memory
  // The firmware binary chunk is stored in the payload variable
  // flash_img_buffered_write()
  return 0;
}

int request_firmware_info() {
  LOG_INF("Requesting firmware info");
  char topic[100];
  sprintf(topic, "v1/devices/me/attributes/request/%d", firmware_request_id);
  char keys[] = "{\"sharedKeys\" : "
                "\"fw_checksum,fw_checksum_algorithm,fw_size,fw_title,fw_"
                "version,fw_state\"}";
  int rc = send_message(topic, keys);
  if (rc < 0) {
    LOG_ERR("Failed to request firmware info: %d", rc);
  } else {
    LOG_INF("Firmware info request published successfully");
  }
  return rc;
}

int send_telemetry(char *payload) {
  return send_message((char *)CONFIG_TB_PUBLISH_TOPIC, payload);
}

int extract_string(const char *json, const char *key, char *value) {
  struct json_key_value kv;
  struct json_obj_descr descr[] = {
      JSON_OBJ_DESCR_PRIM_NAMED(struct json_key_value, value, value,
                                JSON_TOK_STRING),
  };

  int ret = json_obj_parse(json, strlen(json), descr, ARRAY_SIZE(descr), &kv);
  if (ret < 0) {
    LOG_ERR("Failed to extract string for key %s: %d", key, ret);
    return ret;
  }

  strcpy(value, kv.value);
  return 0;
}

int extract_number(const char *json, const char *key, int *value) {
  struct json_key_value kv;
  struct json_obj_descr descr[] = {
      JSON_OBJ_DESCR_PRIM_NAMED(struct json_key_value, value, value,
                                JSON_TOK_NUMBER),
  };

  int ret = json_obj_parse(json, strlen(json), descr, ARRAY_SIZE(descr), &kv);
  if (ret < 0) {
    LOG_ERR("Failed to extract number for key %s: %d", key, ret);
    return ret;
  }

  *value = kv.value;
  return 0;
}

void process_firmware_chunk(const uint8_t *chunk, size_t chunk_size,
                            int chunk_num) {
  LOG_INF("Processing firmware chunk %d with size %zu", chunk_num, chunk_size);
}

int get_firmware(int chunk_number) {
  static char update_request_topic[256];
  int ret;

  ret = update_request_topic_name(update_request_topic, chunk_number);
  if (ret != 0) {
    LOG_ERR("Failed to update request topic name: %d", ret);
    return ret;
  }
  static char payload[100];
  sprintf(payload, "%d", firmware_chunk_size);
  send_message(update_request_topic, payload);

  return 0;
}

int on_connect() {
  int rc;

  struct mqtt_topic topics[] = {
      {.topic = {.utf8 = CONFIG_TB_SUBSCRIBE_TOPIC,
                 .size = strlen(CONFIG_TB_SUBSCRIBE_TOPIC)},
       .qos = MQTT_QOS_1_AT_LEAST_ONCE},
      {.topic = {.utf8 = "v1/devices/me/attributes/response/+",
                 .size = strlen("v1/devices/me/attributes/response/+")},
       .qos = MQTT_QOS_1_AT_LEAST_ONCE},
      {.topic = {.utf8 = "v2/fw/response/+",
                 .size = strlen("v2/fw/response/+")},
       .qos = MQTT_QOS_1_AT_LEAST_ONCE},
      {.topic = {.utf8 = "v2/fw/response/+/chunk/+",
                 .size = strlen("v2/fw/response/+/chunk/+")},
       .qos = MQTT_QOS_1_AT_LEAST_ONCE}};

  const struct mqtt_subscription_list sub_list = {
      .list = topics,
      .list_count = ARRAY_SIZE(topics),
      .message_id = 1u,
  };

  rc = mqtt_subscribe(&client_ctx, &sub_list);
  if (rc != 0) {
    LOG_ERR("Subscribe to topics failed: %d", rc);
    return rc;
  }

  LOG_INF("Subscribed to all topics successfully");

  rc = send_telemetry(current_firmware_to_json());
  if (rc != 0) {
    LOG_ERR("Failed to send telemetry data: %d", rc);
    return rc;
  }

  rc = request_firmware_info();
  if (rc != 0) {
    LOG_ERR("Failed to request firmware info: %d", rc);
    return rc;
  }

  rc = get_firmware(0);
  if (rc != 0) {
    LOG_ERR("Failed to start firmware download: %d", rc);
    return rc;

    return 0;
  }
}

void handle_firmware_info(const uint8_t *payload, size_t payload_len) {
  char title[128];
  char version[128];
  int size;

  if (extract_string((const char *)payload, "fw_title", title) < 0) {
    LOG_ERR("Failed to extract firmware title");
    return;
  }

  if (extract_string((const char *)payload, "fw_version", version) < 0) {
    LOG_ERR("Failed to extract firmware version");
    return;
  }

  if (extract_number((const char *)payload, "fw_size", &size) < 0) {
    LOG_ERR("Failed to extract firmware size");
    return;
  }

  LOG_INF("Firmware title: %s", title);
  LOG_INF("Firmware version: %s", version);
  LOG_INF("Firmware size: %d", size);

  if (strcmp(version, current_firmware_version) != 0) {
    LOG_INF("New firmware version available: %s - %s", title, version);
    char telemetry_payload[200];
    snprintf(telemetry_payload, sizeof(telemetry_payload),
             "{\"fw_state\" :\"DOWNLOADING\", \"current_fw_version\":\"%s\", "
             "\"current_fw_title\":\"%s\"}",
             current_firmware_version, current_firmware_title);
    send_telemetry(telemetry_payload);
    k_sleep(K_SECONDS(1));

    firmware_request_id++;

    chunk_count = (size + firmware_chunk_size - 1) / firmware_chunk_size;
    LOG_INF("Chunk count: %d", chunk_count);

  } else {
    LOG_INF("Firmware version is up to date: %s", version);
  }
}

ssize_t process_message(const struct mqtt_publish_param *pub, uint8_t *buff, size_t buff_len) {
  char update_response_topic[256];
  update_response_topic_name(update_response_topic);

  printf("Message arrived on topic %.*s\n", pub->message.topic.topic.size,
         pub->message.topic.topic.utf8);

  // Test if topic starts with v1/devices/me/attributes
  if (0 ==
      strncmp(pub->message.topic.topic.utf8, "v1/devices/me/attributes", 24)) {
    // check if topic contains "response"
    if (strstr(pub->message.topic.topic.utf8, "/response/") != NULL) {
      // put \0 at the end of the message payload
      ((char *)pub->message.payload.data)[pub->message.payload.len] = '\0';
      printf("Payload: %s\n", (char *)pub->message.payload.data);

      // get firmware version
      static char version[100];
      extract_string((char *)pub->message.payload.data,
                     (char *)"shared.fw_version", version);

      // get firmware title
      static char title[100];
      extract_string((char *)pub->message.payload.data,
                     (char *)"shared.fw_title", title);

      // if version or title is different from current version, update
      if (strcmp(version, current_firmware_version) != 0) {
        printf("New firmware version available: %s - %s\n", title, version);
        char telemetry_payload[200];
        sprintf(
            telemetry_payload,
            "{\"fw_state\" :\"DOWNLOADING\", \"current_fw_version\":\"%s\", "
            "\"current_fw_title\":\"%s\"}",
            current_firmware_version, current_firmware_title);
        send_telemetry(telemetry_payload);
        k_sleep(K_SECONDS(1));

        firmware_request_id++;

        int firmware_size = 0;
        extract_number((char *)pub->message.payload.data,
                       (char *)"shared.fw_size", &firmware_size);
        printf("Firmware size: %d\n", firmware_size);

        chunk_count =
            (firmware_size + firmware_chunk_size - 1) / firmware_chunk_size;
        printf("Chunk count: %d\n", chunk_count);

        // Assuming secondary_bd is initialized elsewhere
        /* if (secondary_bd->init() != 0) {
             printf("Init failed\n");
         }*/

        get_firmware(0);
      } else {
        // force start update
        get_firmware(0);
        printf("Firmware version is up to date: %s\n", version);
      }
    }
  } else if (0 == strncmp(pub->message.topic.topic.utf8, update_response_topic,
                          strlen(update_response_topic))) {
    printf("\n\nFirmware Chunk received!\n\n");
    
    sscanf(pub->message.topic.topic.utf8, "v2/fw/response/%d/chunk/%d",
           &firmware_request_id, &chunk_number);
    
    store_firmware_chunk(buff, chunk_number,
                         buff_len);

   
    // TODO: use fw info to determine if firmware download is complete
    if (chunk_number >= 10) {
       printf("Firmware download completed\n");
    } else {
       chunk_number++;
      get_firmware(chunk_number);
    }      

    
    // if (chunk_number < chunk_count - 1) {
    //       do_firmware_update = true;    
    //   } else {
    //       do_firmware_update = false;
    //       printf("Firmware download completed\n");
    //   }

  }

  return 0; // Adjust return value as needed
}
```

## src/mqtt_firmware_update.h
```c
#ifndef MQTT_FIRMWARE_UPDATE_H
#define MQTT_FIRMWARE_UPDATE_H

#include <zephyr/kernel.h>
#include <zephyr/data/json.h>
#include <zephyr/logging/log.h>
#include <zephyr/net/mqtt.h>

struct firmware_info {
    char title[64];
    char version[16];
    int size;
};

extern struct mqtt_client client_ctx;
extern int firmware_request_id;
extern int chunk_count;
extern int chunk_number;
extern int firmware_chunk_size;
extern bool do_firmware_update;

static char current_firmware_version[24]; 
static char current_firmware_title[64];   

int request_firmware_info();
void handle_firmware_info(const uint8_t *data, size_t len);
void process_firmware_chunk(const uint8_t *data, size_t len, int chunk_num);
int get_firmware(int chunk_number); // Add this line
int update_request_topic_name(char *topic_name, int chunk_number);
int send_message(char *topic, char *payload);
char *current_firmware_to_json();
int store_firmware_chunk(void *payload, int chunk_number, int chunk_len);
ssize_t process_message(const struct mqtt_publish_param *pub, uint8_t *buff, size_t buff_len);

int on_connect();

#endif // MQTT_FIRMWARE_UPDATE_H
```
